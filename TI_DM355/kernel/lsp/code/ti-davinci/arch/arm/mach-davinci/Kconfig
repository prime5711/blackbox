## TI_DM355/kernel/lsp/code/ti-davinci/arch/arm/mach-davinci/Kconfig
```kconfig
if ARCH_DAVINCI

menu "TI DaVinci Implementations"

comment "DaVinci Core Type"

config ARCH_DAVINCI644x
	default y
	bool "DaVinci 644x based system"

config ARCH_DAVINCI355
	default n
	bool "DaVinci DM355 based system"

comment "DaVinci Board Type"

config MACH_DAVINCI_EVM
	bool "TI DaVinci EVM"
	default y
	depends on ARCH_DAVINCI644x
	help
	  Configure this option to specify the whether the board used
	  for development is a DaVinci EVM

config MACH_DAVINCI_DM355_EVM
	bool "TI DM355 EVM"
	default n
	depends on ARCH_DAVINCI355
	help
	  Configure this option to specify the whether the board used
	  for development is a DM355 EVM
	  
config MACH_DAVINCI_DM355_IPNC
	bool "TI DM355 IPNC"
	default n
	depends on ARCH_DAVINCI355
	help
	  Configure this option to specify the whether the board used
	  for development is a DM355 IPNC


config MACH_DAVINCI_DM355_IPNC_WIFI_MTD
	bool "TI DM355 IPNC MTD for WiFi 2_5M/1_5M"
	default n
	depends on ARCH_DAVINCI355
	help
	  Org Kernel partition 2M/2M however WiFi version is 2_5M/1_5M 


config DAVINCI_I2C_EXPANDER
	bool "TI DaVinci I2C Expander"
	default y
	depends on ARCH_DAVINCI644x
	select I2C_DAVINCI
	help
	  Configure this option to specify whether the board used
	  has I2C exapnder with ATA, USB, CF.

config DAVINCI_MCBSP
	bool
        prompt "DaVinci McBSP Driver" if SOUND_DAVINCI=n
	depends on ARCH_DAVINCI
	default SOUND_DAVINCI
	---help---
	DaVinci McBSP driver.  Auto-enabled by DaVinci sound driver.

comment "DaVinci Options"

config DAVINCI_BLK_DEV_CF
	bool "TI DaVinci CF Card Support"
	default Y
	depends on BLK_DEV_DAVINCI
	help
	  Configure this option to enable CF Card support.

config DM355_NAND_256KB_BLOCKS
	bool "NAND chip installed on DM355 EVM has 256KB blocks"
	default y
	depends on MACH_DAVINCI_DM355_EVM||MACH_DAVINCI_DM355_IPNC
	help
	  The boot firmware on the DM355 EVM assumes a default partition map
	  for NAND flash based on erase block offsets.  Thus, the partition map
	  varies based on the size of the erase blocks in the particular NAND
	  flash component installed on the board.  Answer Y here if the NAND
	  chip (e.g a 16 Gigabit Micron MT29F16G08QAA) installed on your board
	  has 256KB blocks.  Answer N here if the NAND chip (e.g. a 4 Gigabit
	  Micron MT29F4G08AAA) installed on your board has 128KB blocks.

choice
	prompt "Low-level debug console UART"
	default DAVINCI_LL_DEBUG_UART0

config DAVINCI_LL_DEBUG_UART0
	bool "UART0"

config DAVINCI_LL_DEBUG_UART1
	bool "UART1"

endchoice

config DM355_SPI
        bool "TI DM355 SPI device"
        default y
        help
          Configure this option to specify whether the board used
          has SPI device.

endmenu

endif
```

## TI_DM355/kernel/lsp/code/ti-davinci/arch/arm/mach-pxa/Kconfig
```kconfig
if ARCH_PXA

menu "Intel PXA2xx Implementations"

choice
	prompt "Select target board"

config ARCH_LUBBOCK
	bool "Intel DBPXA250 Development Platform"
	select PXA25x

config MACH_MAINSTONE
	bool "Intel HCDDBBVA0 Development Platform"
	select PXA27x
	select IWMMXT

config ARCH_PXA_IDP
	bool "Accelent Xscale IDP"
	select PXA25x


config MACH_ZYLONITE
	bool "Zylonite Development Platform"
	select PXA3xx
	select IWMMXT
	select CPU_XSC3

endchoice

endmenu

config PXA25x
	bool
	help
	  Select code specific to PXA21x/25x/26x variants

config PXA27x
	bool
	help
	  Select code specific to PXA27x variants

config PXA3xx
	bool
	help
	  Select code specific to Intel(R) processor PXA3xx variants

config IWMMXT
	bool
	help
	  Enable support for iWMMXt

endif
```

## TI_DM355/kernel/lsp/code/ti-davinci/drivers/media/Kconfig
```kconfig
#
# Multimedia device configuration
#

menu "Multimedia devices"

config VIDEO_DEV
        tristate "Video For Linux && V4L2"
        ---help---
          V4L core support for video capture and overlay devices, webcams and
          AM/FM radio cards.

          This kernel includes support for the new Video for Linux Two API,
          (V4L2).

          Additional info and docs are available on the web at
          <http://linuxtv.org>

          Documentation for V4L2 is also available on the web at
          <http://bytesex.org/v4l/>.

          To compile this driver as a module, choose M here: the
          module will be called videodev.

source "drivers/media/video/Kconfig"

source "drivers/media/radio/Kconfig"

source "drivers/media/dvb/Kconfig"

source "drivers/media/common/Kconfig"

config VIDEO_TUNER
	tristate

config VIDEO_BUF
	tristate

config VIDEO_BUF_DVB
	tristate

config VIDEO_BTCX
	tristate

config VIDEO_IR
	tristate

endmenu
```

## TI_DM355/kernel/lsp/code/ti-davinci/drivers/net/brcm/Kconfig
```kconfig
#
# Broadcom Home Networking Division (HND) driver configuration
#
# Copyright (C) 2004 Broadcom Corporation
#
# This program is free software; you can redistribute it and/or
# modify it under the terms of the GNU General Public License
# as published by the Free Software Foundation; either version 2
# of the License, or (at your option) any later version.
#
# This program is distributed in the hope that it will be useful,
# but WITHOUT ANY WARRANTY; without even the implied warranty of
# MERCHANTABILITY or FITNESS FOR A PARTICULAR PURPOSE.  See the
# GNU General Public License for more details.
#
# You should have received a copy of the GNU General Public License
# along with this program; if not, write to the Free Software
# Foundation, Inc., 59 Temple Place - Suite 330, Boston, MA 02111-1307, USA.
#
#

# mainmenu_option next_comment
menu "Broadcom network devices"

config HND
   tristate "Broadcom network device support"
   depends on PCI

config ET
     tristate "  Broadcom 10/100 Ethernet support"
     depends on HND

config ET_47XX
     bool "  Broadcom BCM53xx/BCM47xx support"
     depends on ET

config ROBO
     tristate "  Broadcom BCM53xx ROBOSwitch support"
     depends on HND

config WL
     tristate "  Broadcom BCM43xx 802.11 Wireless support"
     depends on HND

config STRATA
     tristate "  Broadcom BCM56xx Ethernet Switch support"
     depends on HND

config WL_AP
     bool "    Access Point Mode"
     depends on WL

config  CONFIG_USBDEV
     tristate "    Broadcom BCM47xx RNDIS USB support"
     depends on HND

endmenu
```
